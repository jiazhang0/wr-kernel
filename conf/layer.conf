## conf/layer.conf
```bitbake
#
# Copyright (C) 2013 Wind River Systems, Inc.
#
BBPATH ?= ""
# We have a conf and classes directory, add to BBPATH
BBPATH := "${LAYERDIR}:${BBPATH}"

# We have a packages directory, add to BBFILES
BBFILES := "${BBFILES} ${LAYERDIR}/recipes-*/*/*.bb \
	${LAYERDIR}/meta-virtualization/recipes*/*/*.bb \
	${LAYERDIR}/meta-virtualization/recipes*/*/*.bbappend \
	${LAYERDIR}/meta-realtime/recipes*/*/*.bb \
	${LAYERDIR}/meta-realtime/recipes*/*/*.bbappend \
	${LAYERDIR}/recipes-*/*/*.bbappend \
	${LAYERDIR}/classes/*.bbclass"

BBFILE_COLLECTIONS += "wr-kernel"
BBFILE_PATTERN_wr-kernel := "^${LAYERDIR}/"
BBFILE_PRIORITY_wr-kernel = "6"

BBMASK ?= "/(linux-yocto)"

PREFERRED_PROVIDER_virtual/kernel = "linux-windriver"
PREFERRED_VERSION_linux-windriver ?= "3.14%"

# We have a pre-populated downloads directory, add to PREMIRRORS
PREMIRRORS_append := " \
     git://.*/.* file://${LAYERDIR}/downloads/ \n \
     svn://.*/.* file://${LAYERDIR}/downloads/ \n \
     ftp://.*/.* file://${LAYERDIR}/downloads/ \n \
     http://.*/.* file://${LAYERDIR}/downloads/ \n \
     https://.*/.* file://${LAYERDIR}/downloads/ \n"

# This should only be incremented on significant changes that will
# cause compatibility issues with other layers
LAYERVERSION_wr-kernel = "1"

LAYERDEPENDS_wr-kernel = "core wr-userspace-base networking-layer"

require wr-kernel_blacklist.conf

# Keep these premirrors in sync with the above premirros including the protocols.
WRL_MIRRORS_append = "\
     git://.*/.*/   https://${WRL_MIRRORS_BASE}/WRLinux-7-Core/wr-kernel-dl/${WRL_MIRRORS_SHOW_BRANCH}:/ \n \
     svn://.*/.*/   https://${WRL_MIRRORS_BASE}/WRLinux-7-Core/wr-kernel-dl/${WRL_MIRRORS_SHOW_BRANCH}:/ \n \
     ftp://.*/.*/   https://${WRL_MIRRORS_BASE}/WRLinux-7-Core/wr-kernel-dl/${WRL_MIRRORS_SHOW_BRANCH}:/ \n \
     http://.*/.*/  https://${WRL_MIRRORS_BASE}/WRLinux-7-Core/wr-kernel-dl/${WRL_MIRRORS_SHOW_BRANCH}:/ \n \
     https://.*/.*/ https://${WRL_MIRRORS_BASE}/WRLinux-7-Core/wr-kernel-dl/${WRL_MIRRORS_SHOW_BRANCH}:/ \n \
"
```
